/**
 * @cliArgs --board "/ti/boards/CC3220SF_LAUNCHXL" --product "simplelink_cc32xx_sdk@4.30.00.06"
 * @versions {"data":"2020090214","timestamp":"2020090214","tool":"1.6.0+1543","templates":"2020090214"}
 */

/**
 * Import the modules used in this configuration.
 */
const GPIO  = scripting.addModule("/ti/drivers/GPIO", {}, false);
const GPIO1 = GPIO.addInstance();
const GPIO2 = GPIO.addInstance();
const GPIO3 = GPIO.addInstance();
const I2C   = scripting.addModule("/ti/drivers/I2C", {}, false);
const I2C1  = I2C.addInstance();
const PWM   = scripting.addModule("/ti/drivers/PWM");
const PWM1  = PWM.addInstance();
const PWM2  = PWM.addInstance();
const RTOS  = scripting.addModule("/ti/drivers/RTOS");

/**
 * Write custom configuration values to the imported modules.
 */
GPIO1.$name                         = "IN1";
GPIO1.mode                          = "Output";
GPIO1.gpioPin.$assignAllowConflicts = "boosterpack.4";

GPIO2.$name                         = "IN2";
GPIO2.mode                          = "Output";
GPIO2.gpioPin.$assignAllowConflicts = "boosterpack.7";

GPIO3.$name           = "DRIVE_EN";
GPIO3.mode            = "Output";
GPIO3.gpioPin.$assign = "boosterpack.14";

I2C1.$name                            = "CONFIG_I2C_0";
I2C1.i2c.sdaPin.$assign               = "boosterpack.3";
I2C1.i2c.sclPin.$assignAllowConflicts = "boosterpack.7";

PWM1.$name     = "CONFIG_PWM_0";
PWM1.$hardware = system.deviceData.board.components.LED_YELLOW;

PWM2.$name     = "CONFIG_PWM_1";
PWM2.$hardware = system.deviceData.board.components.LED_GREEN;

const Power          = scripting.addModule("/ti/drivers/Power", {}, false);
Power.parkPins.$name = "ti_drivers_power_PowerCC32XXPins0";

RTOS.name = "NoRTOS";

/**
 * Pinmux solution for unlocked pins/peripherals. This ensures that minor changes to the automatic solver in a future
 * version of the tool will not impact the pinmux you originally saw.  These lines can be completely deleted in order to
 * re-solve from scratch.
 */
I2C1.i2c.$suggestSolution          = "I2C0";
PWM1.timer.$suggestSolution        = "Timer3";
PWM1.timer.pwmPin.$suggestSolution = "boosterpack.9";
PWM2.timer.$suggestSolution        = "Timer3";
PWM2.timer.pwmPin.$suggestSolution = "boosterpack.10";
